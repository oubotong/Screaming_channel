## CMakeLists.txt
```
#
# Copyright (c) 2020 Nordic Semiconductor
#
# SPDX-License-Identifier: LicenseRef-Nordic-5-Clause
#

cmake_minimum_required(VERSION 3.13.1)

find_package(Zephyr REQUIRED HINTS $ENV{ZEPHYR_BASE})
project(NONE)

# Application sources
#target_sources_ifdef(CONFIG_NRF21540_FEM app
#	PRIVATE ../../bluetooth/direct_test_mode/src/fem/nrf21540.c)
#zephyr_include_directories(../../bluetooth/direct_test_mode/src/fem/)

FILE(GLOB app_sources src/*.c)
# NORDIC SDK APP START
target_sources(app PRIVATE
	${app_sources}
)
# NORDIC SDK APP END
```

## prj.conf
```kconfig
#
# Copyright (c) 2020 Nordic Semiconductor
#
# SPDX-License-Identifier: LicenseRef-Nordic-5-Clause
#

CONFIG_CONSOLE_HANDLER=y
CONFIG_SHELL=y
CONFIG_FLASH_SHELL=y
CONFIG_NEWLIB_LIBC=y
CONFIG_DYNAMIC_INTERRUPTS=y

CONFIG_NRFX_TIMER0=y
```

## src/main.c
```c
/**
 * Copyright (c) 2014 - 2017, Nordic Semiconductor ASA
 *
 * All rights reserved.
 *
 * Redistribution and use in source and binary forms, with or without modification,
 * are permitted provided that the following conditions are met:
 *
 * 1. Redistributions of source code must retain the above copyright notice, this
 *    list of conditions and the following disclaimer.
 *
 * 2. Redistributions in binary form, except as embedded into a Nordic
 *    Semiconductor ASA integrated circuit in a product or a software update for
 *    such product, must reproduce the above copyright notice, this list of
 *    conditions and the following disclaimer in the documentation and/or other
 *    materials provided with the distribution.
 *
 * 3. Neither the name of Nordic Semiconductor ASA nor the names of its
 *    contributors may be used to endorse or promote products derived from this
 *    software without specific prior written permission.
 *
 * 4. This software, with or without modification, must only be used with a
 *    Nordic Semiconductor ASA integrated circuit.
 *
 * 5. Any software provided in binary form under this license must not be reverse
 *    engineered, decompiled, modified and/or disassembled.
 *
 * THIS SOFTWARE IS PROVIDED BY NORDIC SEMICONDUCTOR ASA "AS IS" AND ANY EXPRESS
 * OR IMPLIED WARRANTIES, INCLUDING, BUT NOT LIMITED TO, THE IMPLIED WARRANTIES
 * OF MERCHANTABILITY, NONINFRINGEMENT, AND FITNESS FOR A PARTICULAR PURPOSE ARE
 * DISCLAIMED. IN NO EVENT SHALL NORDIC SEMICONDUCTOR ASA OR CONTRIBUTORS BE
 * LIABLE FOR ANY DIRECT, INDIRECT, INCIDENTAL, SPECIAL, EXEMPLARY, OR
 * CONSEQUENTIAL DAMAGES (INCLUDING, BUT NOT LIMITED TO, PROCUREMENT OF SUBSTITUTE
 * GOODS OR SERVICES; LOSS OF USE, DATA, OR PROFITS; OR BUSINESS INTERRUPTION)
 * HOWEVER CAUSED AND ON ANY THEORY OF LIABILITY, WHETHER IN CONTRACT, STRICT
 * LIABILITY, OR TORT (INCLUDING NEGLIGENCE OR OTHERWISE) ARISING IN ANY WAY OUT
 * OF THE USE OF THIS SOFTWARE, EVEN IF ADVISED OF THE POSSIBILITY OF SUCH DAMAGE.
 *
 */
/** @file
*
* @defgroup nrf_radio_test_example_main main.c
* @{
* @ingroup nrf_radio_test_example
* @brief Radio Test Example Application main file.
*
* This file contains the source code for a sample application using the NRF_RADIO, and is controlled through the serial port.
*
*/

#include <zephyr.h>
#include <device.h>
#include <stdint.h>
#include <stdbool.h>
#include <stdio.h>
#include "nrf.h"
#include "radio_test.h"
#include <unistd.h>



/*
 * Poor man's hexdump
 *
 * Only for byte arrays! We sleep a bit for longer arrays to make sure that
 * we're not faster than the serial port. Also, newlines every now and then seem
 * to be necessary to flush a buffer somewhere.
 */
#define hexdump(byte_arr)                               \
    do {                                                \
        printf("(%u bytes) ", sizeof(byte_arr));        \
        for (size_t i = 0; i < sizeof(byte_arr); ++i) { \
            if (i % 32 == 0) {                          \
                printf("\r\n");                         \
            }                                           \
                                                        \
            printf("%02x", byte_arr[i]);                \
        }                                               \
    } while (0)

static uint8_t mode_          = RADIO_MODE_MODE_Ble_1Mbit;
static uint8_t txpower_       = RADIO_TXPOWER_TXPOWER_0dBm;
static int channel_start_     = 0;
static int channel_end_       = 80;
static int delayms_           = 10;
//static uint8_t rcounter_      = 0;

typedef enum
{
    RADIO_TEST_NOP,             /**< No test running.                                */
    RADIO_TEST_TXCC,            /**< TX constant carrier.                            */
    RADIO_TEST_TXMC,            /**< TX modulated carrier.                           */
    RADIO_TEST_TXSWEEP,         /**< TX sweep.                                       */
    RADIO_TEST_RXC,             /**< RX constant carrier.                            */
    RADIO_TEST_RXSWEEP,         /**< RX sweep.                                       */
    RADIO_TEST_NOISYOP,         /**< Some noisy op.                                  */
} radio_tests_t;

#define BELL 7 // Bell

/** @brief Function for configuring all peripherals used in this example.
*/
static void init(void)
{
    NRF_RNG_NS->TASKS_START = 1;

    // Start 16 MHz crystal oscillator
    NRF_CLOCK_NS->EVENTS_HFCLKSTARTED  = 0;
    NRF_CLOCK_NS->TASKS_HFCLKSTART     = 1;

    // Wait for the external oscillator to start up
    while (NRF_CLOCK_NS->EVENTS_HFCLKSTARTED == 0)
    {
        // Do nothing.
    }
}


/** @brief Function for outputting usage info to the serial port.
*/
static void help(void)
{
    printf("Usage:\r\n");
    printf("a: Enter start channel for sweep/channel for constant carrier\r\n");
    printf("b: Enter end channel for sweep\r\n");
    printf("c: Start TX carrier\r\n");
    printf("d: Enter time on each channel (1ms-99ms)\r\n");
    printf("e: Cancel sweep/carrier\r\n");
    printf("l: Test the crypto hardware\r\n");

    printf("m: Enter data rate\r\n");
    printf("o: Start modulated TX carrier\r\n");
    printf("p: Enter output power\r\n");
    printf("q: Start modulated TX carrier with encryption\r\n");
    printf("s: Print current delay, channels and so on\r\n");
    printf("r: Start RX sweep\r\n");
    printf("t: Start TX sweep\r\n");
    printf("x: Start RX carrier\r\n");
    printf("y: Start noisy operation\r\n");
    printf("z: End noisy operation\r\n");

    printf("v: Enter simplified power analysis mode\r\n");
    printf("   m: Enter switching mask\r\n");
    printf("   s: Switch\r\n");
    printf("   q: Quit power analysis mode\r\n");

}


/** @brief Function for reading the data rate.
*/
void get_datarate(void)
{
    uint8_t c;

#ifndef NRF52840_XXAA
    printf("Enter data rate ('0'=250 Kbit/s, '1'=1 Mbit/s, '2'=2 Mbit/s and '3'=BLE 1 Mbit/s):\r\n");
#else
    printf("Enter data rate ('1'=1 Mbit/s, '2'=2 Mbit/s and '3'=BLE 1 Mbit/s):\r\n");
#endif //NRF52840_XXAA
    while (true)
    {
        scanf("%c",&c);
        if ((c >= '0') && (c <= '2'))
        {
            printf("%c\r\n",c);
            break;
        }
        else
        {
            printf("%c\r\n",BELL);
        }
    }

    if (c == '1')
    {
        mode_ = RADIO_MODE_MODE_Nrf_1Mbit;
    }
    else if (c == '2')
    {
        mode_ = RADIO_MODE_MODE_Nrf_2Mbit;
    }
    else if (c == '3')
    {
        mode_ = RADIO_MODE_MODE_Ble_1Mbit;
    }
    printf("\r\n");
}


/** @brief Function for reading the output power.
*/
void get_power(void)
{
    uint8_t c;

    printf("Enter output power ('0'=+4 dBm, '1'=0 dBm,...,'7'=-30 dBm):\r\n");
    c=1;

    switch (c)
    {

        case '1':
            txpower_ =  RADIO_TXPOWER_TXPOWER_0dBm;
            break;

        case '2':
            txpower_ = RADIO_TXPOWER_TXPOWER_Neg4dBm;
            break;

        case '3':
            txpower_ = RADIO_TXPOWER_TXPOWER_Neg8dBm;
            break;

        case '4':
            txpower_ = RADIO_TXPOWER_TXPOWER_Neg12dBm;
            break;

        case '5':
            txpower_ = RADIO_TXPOWER_TXPOWER_Neg16dBm;
            break;

        case '6':
            txpower_ = RADIO_TXPOWER_TXPOWER_Neg20dBm;
            break;

        case '7':
            // fall through

        default:
            txpower_ = RADIO_TXPOWER_TXPOWER_Neg30dBm;
            break;
    }
    printf("\r\n");
}


/** @brief Function for printing parameters to the serial port.
*/
void print_parameters(void)
{
    printf("Parameters:\r\n");
    switch (mode_)
    {

        case RADIO_MODE_MODE_Nrf_1Mbit:
            printf("Data rate...........: 1 Mbit/s\r\n");
            break;

        case RADIO_MODE_MODE_Nrf_2Mbit:
            printf("Data rate...........: 2 Mbit/s\r\n");
            break;

        case RADIO_MODE_MODE_Ble_1Mbit:
            printf("Data rate...........: BLE 1 Mbit/s\r\n");
            break;
    }

    switch (txpower_)
    {

        case RADIO_TXPOWER_TXPOWER_0dBm:
            printf("TX Power............: 0 dBm\r\n");
            break;

        case RADIO_TXPOWER_TXPOWER_Neg4dBm:
            printf("TX Power............: -4 dBm\r\n");
            break;

        case RADIO_TXPOWER_TXPOWER_Neg8dBm:
            printf("TX Power............: -8 dBm\r\n");
            break;

        case RADIO_TXPOWER_TXPOWER_Neg12dBm:
            printf("TX Power............: -12 dBm\r\n");
            break;

        case RADIO_TXPOWER_TXPOWER_Neg16dBm:
            printf("TX Power............: -16 dBm\r\n");
            break;

        case RADIO_TXPOWER_TXPOWER_Neg20dBm:
            printf("TX Power............: -20 dBm\r\n");
            break;

        case RADIO_TXPOWER_TXPOWER_Neg30dBm:
            printf("TX Power............: -30 dBm\r\n");
            break;

        default:
            // No implementation needed.
            break;

    }
    printf("(Start) Channel.....: %d\r\n",channel_start_);
    printf("End Channel.........: %d\r\n",channel_end_);
    printf("Time on each channel: %d ms\r\n",delayms_);
    printf("Low frequency clock.: %s\r\n",
           (NRF_CLOCK_NS->LFCLKSTAT & CLOCK_LFCLKSTAT_STATE_Msk) ? "on" : "off");
}

bool timer1_init()
{
    NRF_TIMER1_NS->TASKS_STOP  = 1;
    NRF_TIMER1_NS->TASKS_CLEAR = 1;
    NRF_TIMER1_NS->INTENCLR    = 0xffffffff;
    NRF_TIMER1_NS->INTENSET    = TIMER_INTENSET_COMPARE0_Msk;

    NRF_TIMER1_NS->SHORTS    = (1 << TIMER_SHORTS_COMPARE0_CLEAR_Pos);
    NRF_TIMER1_NS->PRESCALER = 22; // f_timer = 16MHz/(2^prescalar)

    NRF_TIMER1_NS->CC[0] = 0;

    NVIC_ClearPendingIRQ(TIMER1_IRQn);
    NVIC_EnableIRQ(TIMER1_IRQn);
    return true;
}

void start_noisy_op(void)
{
    NRF_TIMER1_NS->TASKS_CLEAR = 1;
    NRF_TIMER1_NS->TASKS_START = 1;
}

void stop_noisy_op(void)
{
    NRF_TIMER1_NS->TASKS_STOP = 1;
}

/*
 * @brief Function to read 16 integers from the serial line and to write them in
 * to a bytearray
 */
void read_128(uint8_t* in){
    int tmp;
    for(int i=0;i<16;i++){
        scanf("%d",&tmp);
        in[i] = (uint8_t)tmp;
    }
    /*scanf("%hhd %hhd %hhd %hhd %hhd %hhd %hhd %hhd %hhd %hhd %hhd %hhd %hhd %hhd %hhd %hhd",*/
           /*&in[ 0],&in[ 1],&in[ 2],&in[ 3],*/
           /*&in[ 4],&in[ 5],&in[ 6],&in[ 7],*/
           /*&in[ 8],&in[ 9],&in[10],&in[11],*/
           /*&in[12],&in[13],&in[14],&in[15]);*/
}

/*
 * @brief Function to write a byte array as 16 integers to the serial line
 */
void write_128(uint8_t* out){
    printf("%d %d %d %d %d %d %d %d %d %d %d %d %d %d %d %d\r\n",
           out[ 0],out[ 1],out[ 2],out[ 3],
           out[ 4],out[ 5],out[ 6],out[ 7],
           out[ 8],out[ 9],out[10],out[11],
           out[12],out[13],out[14],out[15]);
}

/*
 * brief Function that creates a preable for easy alignment
 */
void preamble(){
    typedef uint8_t state_t[4][4];
    state_t state = {0};
    uint8_t i,j;
    for(i=0;i<4;++i)
    {
      for(j = 0; j < 4; ++j)
      {
        state[i][j] ^= 0xff;
      }
    }
    for(i=0;i<4;++i)
    {
      for(j = 0; j < 4; ++j)
      {
        state[i][j] ^= 0xff;
      }
    }
    for(i=0;i<4;++i)
    {
      for(j = 0; j < 4; ++j)
      {
        state[i][j] ^= 0xff;
      }
    }
    for(i=0;i<4;++i)
    {
      for(j = 0; j < 4; ++j)
      {
        state[i][j] ^= 0xff;
      }
    }
    for(i=0;i<4;++i)
    {
      for(j = 0; j < 4; ++j)
      {
        state[i][j] ^= 0xff;
      }
    }
}


/*
 * @brief Function to handle power analysis
 */
void power_analysis_mode(){
    printf("Entering power analysis mode\r\n");
    uint8_t control;
    bool exit = false;
    uint8_t switching_mask[16] = {0};
    while(!exit){
        scanf("%c",&control);
        switch(control){
            case 'p':
                read_128(switching_mask);
                write_128(switching_mask); // dbg
                break;
            case 'q':
                exit = true;
                break;
            default:
                break;
        }
    }
    printf("Exiting power analysis mode\r\n");
}

typedef struct {
    bool sweep;
    bool ccm;
} main_state_t;

/** @brief Helper to switch off all activity.
 */
void all_off(main_state_t* state)
{
    if (state->sweep)
    {
        radio_sweep_end();
        state->sweep = false;
    }
    if (state->ccm)
    {
        state->ccm = false;
    }
}

/** @brief Function for main application entry.
 */
int main(void)
{
    uint32_t err_code;
    radio_tests_t test     = RADIO_TEST_NOP;
    radio_tests_t cur_test = RADIO_TEST_NOP;
    main_state_t state     = {false, false};

    init();
    //bsp_board_leds_init();
    printf("RF Test\r\n");
    NVIC_EnableIRQ(TIMER0_IRQn);
    NVIC_EnableIRQ(TIMER1_IRQn);
    __enable_irq();
    uint8_t control;
    channel_start_=0;
    test = cur_test;
    txpower_ =  RADIO_TXPOWER_TXPOWER_0dBm;
    test = RADIO_TEST_TXCC;
    all_off(&state);
    radio_tx_carrier(txpower_, mode_, channel_start_);
    //k_sleep(K_MSEC(10000));
    //bitcount_main();
        /*switch (control)
        {
            case 'a':
                while (true)
                {
                    printf("Enter start channel (two decimal digits, 00 to 80):\r\n");
                    channel_start_=0;
                    if ((channel_start_ <= 80)&&(channel_start_ >= 0))
                    {
                        printf("%d\r\n", channel_start_);
                        break;
                    }

                    printf("Channel must be between 0 and 80\r\n");
                }
                test = cur_test;
                
                break;

            case 'b':
                while (true)
                {
                    printf("Enter end channel (two decimal digits, 00 to 80):\r\n");
                    scanf("%d",&channel_end_);
                    if ((channel_end_ <= 80)&&(channel_start_ >= 0))
                    {
                        printf("%d\r\n", channel_end_);
                        break;
                    }
                    printf("Channel must be between 0 and 80\r\n");
                }
                test = cur_test;
                break;

            case 'c':
                test = RADIO_TEST_TXCC;
                break;

            case 'd':
                while (true)
                {
                    printf("Enter delay in ms (two decimal digits, 01 to 99):\r\n");
                    scanf("%d",&delayms_);
                    if ((delayms_ > 0) && (delayms_ < 100))
                    {
                        printf("%d\r\n", delayms_);
                        break;
                    }
                    printf("Delay must be between 1 and 99\r\n");
                }
                test = cur_test;
                break;

            case 'e':
                radio_sweep_end();
                cur_test = RADIO_TEST_NOP;
                break;

            case 'm':
                get_datarate();
                test = cur_test;
                break;

            case 'o':
                test = RADIO_TEST_TXMC;
                printf("TX modulated carrier\r\n");
                break;

            case 'p':
                get_power();
                test = cur_test;
                break;

            case 'r':
                test = RADIO_TEST_RXSWEEP;
                printf("RX Sweep\r\n");
                break;

            case 's':
                print_parameters();
                break;

            case 't':
                test = RADIO_TEST_TXSWEEP;
                printf("TX Sweep\r\n");
                break;

            case 'v':
                power_analysis_mode();
                break;

            case 'x':
                test = RADIO_TEST_RXC;
                printf("RX constant carrier\r\n");
                break;

            case 'y':
                test = RADIO_TEST_NOISYOP;
                printf("Exercise the processor\r\n");
                break;

            case 'z':
                stop_noisy_op();
                test = RADIO_TEST_NOP;
                printf("Relax the processor\r\n");
                break;

            case 'h':
                help();
                break;

            default:
                
                break;
        }*/

        /*switch (test)
        {
            case RADIO_TEST_TXCC:
                all_off(&state);
                radio_tx_carrier(txpower_, mode_, channel_start_);
                cur_test = test;
                test     = RADIO_TEST_NOP;
                break;

            case RADIO_TEST_TXMC:
                all_off(&state);
                radio_modulated_tx_carrier(txpower_, mode_, channel_start_);
                cur_test = test;
                test     = RADIO_TEST_NOP;
                break;

            case RADIO_TEST_TXSWEEP:
                all_off(&state);
                radio_tx_sweep_start(txpower_, mode_, channel_start_, channel_end_, delayms_);
                state.sweep = true;
                cur_test = test;
                test     = RADIO_TEST_NOP;
                break;

            case RADIO_TEST_RXC:
                all_off(&state);
                radio_rx_carrier(mode_, channel_start_);
                cur_test = test;
                test     = RADIO_TEST_NOP;
                break;

            case RADIO_TEST_RXSWEEP:
                radio_rx_sweep_start(mode_, channel_start_, channel_end_, delayms_);
                state.sweep = true;
                cur_test = test;
                test     = RADIO_TEST_NOP;
                break;

            case RADIO_TEST_NOISYOP:
                timer1_init();
                start_noisy_op();
                state.sweep    = false;
                cur_test = test;
                test     = RADIO_TEST_NOP;
                break;

            case RADIO_TEST_NOP:
            default:
                break;
        }*/
    //}
}

/** @} */
```

## src/bitcount.c
```c
/*
 * Copyright (c) 2020 Nordic Semiconductor ASA
 *
 * SPDX-License-Identifier: LicenseRef-Nordic-5-Clause
 */

#include <zephyr.h>
#include <drivers/gpio.h>
#include <init.h>
#include <nrf.h>
#include <nrfx.h>

#include <stdio.h>
#include <stdlib.h>
#include "conio.h"
#include <limits.h>
#include <float.h>
#include "bitops.h"

#define FUNCS  7

static int CDECL bit_shifter(long int x);


void bitcount_main(void)
{

  for(int a=0; a<100; a++){  
  //clock_t start, stop;
  double ct, cmin = DBL_MAX, cmax = 0;
  int i, cminix, cmaxix;
  long j, n, seed;
  int iterations;
  static int (* CDECL pBitCntFunc[FUNCS])(long) = {
    bit_count,
    bitcount,
    ntbl_bitcnt,
    ntbl_bitcount,

    BW_btbl_bitcount,
    AR_btbl_bitcount,
    bit_shifter
  };
  static char *text[FUNCS] = {
    "Optimized 1 bit/loop counter",
    "Ratko's mystery algorithm",
    "Recursive bit count by nybbles",
    "Non-recursive bit count by nybbles",

    "Non-recursive bit count by bytes (BW)",
    "Non-recursive bit count by bytes (AR)",
    "Shift and count bits"
  };
  /*if (argc<2) {
    fprintf(stderr,"Usage: bitcnts <iterations>\n");
    exit(-1);
	}*/
  //iterations=atoi(argv[1]);
  iterations=100000;
  
  printf("Loop %d\n", a);
  
  for (i = 0; i < FUNCS; i++) {
    //start = clock();
    
   for (j = n = 0, seed = rand(); j < iterations; j++, seed += 13)
	 n += pBitCntFunc[i](seed);
    
    //stop = clock();
    /*(ct = (stop - start) / (double)CLOCKS_PER_SEC;
    if (ct < cmin) {
	 cmin = ct;
	 cminix = i;
    }
    if (ct > cmax) {
	 cmax = ct;
	 cmaxix = i;
    }
    
    printf("%-38s> Time: %7.3f sec.; Bits: %ld\n", text[i], ct, n);*/
  }
}

  //printf("\nBest  > %s\n", text[cminix]);
  //printf("Worst > %s\n", text[cmaxix]);
  return 0;
	
}



static int CDECL bit_shifter(long int x)
{
  int i, n;
  
  for (i = n = 0; x && (i < (sizeof(long) * CHAR_BIT)); ++i, x >>= 1)
    n += (int)(x & 1L);
  return n;
}
```

## src/radio_test.c
```c
/**
 * Copyright (c) 2009 - 2017, Nordic Semiconductor ASA
 *
 * All rights reserved.
 *
 * Redistribution and use in source and binary forms, with or without modification,
 * are permitted provided that the following conditions are met:
 *
 * 1. Redistributions of source code must retain the above copyright notice, this
 *    list of conditions and the following disclaimer.
 *
 * 2. Redistributions in binary form, except as embedded into a Nordic
 *    Semiconductor ASA integrated circuit in a product or a software update for
 *    such product, must reproduce the above copyright notice, this list of
 *    conditions and the following disclaimer in the documentation and/or other
 *    materials provided with the distribution.
 *
 * 3. Neither the name of Nordic Semiconductor ASA nor the names of its
 *    contributors may be used to endorse or promote products derived from this
 *    software without specific prior written permission.
 *
 * 4. This software, with or without modification, must only be used with a
 *    Nordic Semiconductor ASA integrated circuit.
 *
 * 5. Any software provided in binary form under this license must not be reverse
 *    engineered, decompiled, modified and/or disassembled.
 *
 * THIS SOFTWARE IS PROVIDED BY NORDIC SEMICONDUCTOR ASA "AS IS" AND ANY EXPRESS
 * OR IMPLIED WARRANTIES, INCLUDING, BUT NOT LIMITED TO, THE IMPLIED WARRANTIES
 * OF MERCHANTABILITY, NONINFRINGEMENT, AND FITNESS FOR A PARTICULAR PURPOSE ARE
 * DISCLAIMED. IN NO EVENT SHALL NORDIC SEMICONDUCTOR ASA OR CONTRIBUTORS BE
 * LIABLE FOR ANY DIRECT, INDIRECT, INCIDENTAL, SPECIAL, EXEMPLARY, OR
 * CONSEQUENTIAL DAMAGES (INCLUDING, BUT NOT LIMITED TO, PROCUREMENT OF SUBSTITUTE
 * GOODS OR SERVICES; LOSS OF USE, DATA, OR PROFITS; OR BUSINESS INTERRUPTION)
 * HOWEVER CAUSED AND ON ANY THEORY OF LIABILITY, WHETHER IN CONTRACT, STRICT
 * LIABILITY, OR TORT (INCLUDING NEGLIGENCE OR OTHERWISE) ARISING IN ANY WAY OUT
 * OF THE USE OF THIS SOFTWARE, EVEN IF ADVISED OF THE POSSIBILITY OF SUCH DAMAGE.
 *
 */
/** @file
* @addtogroup nrf_radio_test_example_main
* @{
*/

#include "radio_test.h"
#include <stdbool.h>
#include "nrf.h"
#include <stdio.h>

static uint8_t packet[256];

static uint8_t mode_;
static uint8_t txpower_;
static uint8_t channel_start_;
static uint8_t channel_end_;
static uint8_t channel_;
static bool    sweep_tx_;

/**
 * @brief Function for initializing Timer 0 in 24 bit timer mode with 1 us resolution.
*/
static void timer0_init(uint8_t delayms)
{
    NRF_TIMER0_NS->TASKS_STOP = 1;

    // Create an Event-Task shortcut to clear Timer 1 on COMPARE[0] event.
    NRF_TIMER0_NS->SHORTS     = (TIMER_SHORTS_COMPARE0_CLEAR_Enabled << TIMER_SHORTS_COMPARE0_CLEAR_Pos);
    NRF_TIMER0_NS->MODE       = TIMER_MODE_MODE_Timer;
    NRF_TIMER0_NS->BITMODE    = (TIMER_BITMODE_BITMODE_24Bit << TIMER_BITMODE_BITMODE_Pos);
    NRF_TIMER0_NS->PRESCALER  = 4;  // 1us resolution
    NRF_TIMER0_NS->INTENSET   = (TIMER_INTENSET_COMPARE0_Set << TIMER_INTENSET_COMPARE0_Pos);

    // Sample update needs to happen as soon as possible. The earliest possible moment is MAX_SAMPLE_LEVELS
    // ticks before changing the output duty cycle.
    NRF_TIMER0_NS->CC[0]       = (uint32_t)delayms * 1000;
    NRF_TIMER0_NS->TASKS_START = 1;
}


/**
 * @brief Function for generating an 8 bit random number using the internal random generator.
*/
static uint32_t rnd8(void)
{
    NRF_RNG_NS->EVENTS_VALRDY = 0;
    while (NRF_RNG_NS->EVENTS_VALRDY == 0)
    {
        // Do nothing.
    }
    return NRF_RNG_NS->VALUE;
}


/**
 * @brief Function for generating a 32 bit random number using the internal random generator.
*/
static uint32_t rnd32(void)
{
    uint8_t  i;
    uint32_t val = 0;

    for (i=0; i<4; i++)
    {
        val <<= 8;
        val  |= rnd8();
    }
    return val;
}


/**
 * @brief Function for configuring the radio to use a random address and a 254 byte random payload.
 * The S0 and S1 fields are not used.
*/
static void generate_modulated_rf_packet(void)
{
    uint8_t i;

    NRF_RADIO_NS->PREFIX0 = rnd8();
    NRF_RADIO_NS->BASE0   = rnd32();

    // Packet configuration:
    // S1 size = 0 bits, S0 size = 0 bytes, payload length size = 8 bits
    NRF_RADIO_NS->PCNF0  = (0UL << RADIO_PCNF0_S1LEN_Pos) |
                        (0UL << RADIO_PCNF0_S0LEN_Pos) |
                        (8UL << RADIO_PCNF0_LFLEN_Pos);
    // Packet configuration:
    // Bit 25: 1 Whitening enabled
    // Bit 24: 1 Big endian,
    // 4 byte base address length (5 byte full address length),
    // 0 byte static length, max 255 byte payload .
    NRF_RADIO_NS->PCNF1  = (RADIO_PCNF1_WHITEEN_Enabled << RADIO_PCNF1_WHITEEN_Pos) |
                        (RADIO_PCNF1_ENDIAN_Big << RADIO_PCNF1_ENDIAN_Pos) |
                        (4UL << RADIO_PCNF1_BALEN_Pos) |
                        (0UL << RADIO_PCNF1_STATLEN_Pos) |
                        (255UL << RADIO_PCNF1_MAXLEN_Pos);
    NRF_RADIO_NS->CRCCNF = (RADIO_CRCCNF_LEN_Disabled << RADIO_CRCCNF_LEN_Pos);
    packet[0]         = 254;    // 254 byte payload.

    // Fill payload with random data.
    for (i = 0; i < 254; i++)
    {
        packet[i + 1] = rnd8();
    }
    NRF_RADIO_NS->PACKETPTR = (uint32_t)packet;
}


static void radio_disable(void)
{
    NRF_RADIO_NS->SHORTS          = 0;
    NRF_RADIO_NS->EVENTS_DISABLED = 0;
#ifdef NRF51
    NRF_RADIO_NS->TEST            = 0;
#endif
    NRF_RADIO_NS->TASKS_DISABLE   = 1;
    while (NRF_RADIO_NS->EVENTS_DISABLED == 0)
    {
        // Do nothing.
    }
    NRF_RADIO_NS->EVENTS_DISABLED = 0;
}


/**
 * @brief Function for stopping Timer 0.
*/
void radio_sweep_end(void)
{
    NRF_TIMER0_NS->TASKS_STOP = 1;
    radio_disable();
}


/**
 * @brief Function for turning on the TX carrier test mode.
*/
void radio_tx_carrier(uint8_t txpower, uint8_t mode, uint8_t channel)
{
    radio_disable();
    NRF_RADIO_NS->SHORTS     = RADIO_SHORTS_READY_START_Msk;
    NRF_RADIO_NS->TXPOWER    = (txpower << RADIO_TXPOWER_TXPOWER_Pos);
    NRF_RADIO_NS->MODE       = (mode << RADIO_MODE_MODE_Pos);
    NRF_RADIO_NS->FREQUENCY  = channel;
#ifdef NRF51
    NRF_RADIO_NS->TEST       = (RADIO_TEST_CONST_CARRIER_Enabled << RADIO_TEST_CONST_CARRIER_Pos) \
                            | (RADIO_TEST_PLL_LOCK_Enabled << RADIO_TEST_PLL_LOCK_Pos);
#endif
    NRF_RADIO_NS->TASKS_TXEN = 1; 
    printf("here\r\n");
}


/**
 * @brief Function for starting modulated TX carrier by repeatedly sending a packet with random address and
 * random payload.
*/
void radio_modulated_tx_carrier(uint8_t txpower, uint8_t mode, uint8_t channel)
{
    radio_disable();
    generate_modulated_rf_packet();
    NRF_RADIO_NS->SHORTS     = RADIO_SHORTS_END_DISABLE_Msk | RADIO_SHORTS_READY_START_Msk | \
                            RADIO_SHORTS_DISABLED_TXEN_Msk;
    NRF_RADIO_NS->TXPOWER    = (txpower << RADIO_TXPOWER_TXPOWER_Pos);
    NRF_RADIO_NS->MODE       = (mode << RADIO_MODE_MODE_Pos);
    NRF_RADIO_NS->FREQUENCY  = channel;
    NRF_RADIO_NS->TASKS_TXEN = 1;
}


/**
 * @brief Function for turning on RX carrier.
*/
void radio_rx_carrier(uint8_t mode, uint8_t channel)
{
    radio_disable();
    NRF_RADIO_NS->SHORTS     = RADIO_SHORTS_READY_START_Msk;
    NRF_RADIO_NS->FREQUENCY  = channel;
    NRF_RADIO_NS->TASKS_RXEN = 1;
}


/**
 * @brief Function for turning on TX carrier sweep. This test uses Timer 0 to restart the TX carrier at different channels.
*/
void radio_tx_sweep_start(uint8_t txpower, uint8_t mode, uint8_t channel_start, uint8_t channel_end, uint8_t delayms)
{
    txpower_       = txpower;
    mode_          = mode;
    channel_start_ = channel_start;
    channel_       = channel_start;
    channel_end_   = channel_end;
    sweep_tx_      = true;
    timer0_init(delayms);
}


/**
 * @brief Function for turning on RX carrier sweep. This test uses Timer 0 to restart the RX carrier at different channels.
*/
void radio_rx_sweep_start(uint8_t mode, uint8_t channel_start, uint8_t channel_end, uint8_t delayms)
{
    mode_          = mode;
    channel_start_ = channel_start;
    channel_       = channel_start;
    channel_end_   = channel_end;
    sweep_tx_      = false;
    timer0_init(delayms);
}


/**
 * @brief Function for handling the Timer 0 interrupt used for TX/RX sweep. The carrier is started with the new channel,
 * and the channel is incremented for the next interrupt.
*/
void TIMER0_IRQHandler(void)
{
    if (sweep_tx_)
    {
        radio_tx_carrier(txpower_, mode_, channel_);
    }
    else
    {
        radio_rx_carrier(mode_, channel_);
    }
    channel_++;
    if (channel_ > channel_end_)
    {
        channel_ = channel_start_;
    }
    NRF_TIMER0_NS->EVENTS_COMPARE[0] = 0;
}
/**
 * @}
 */
```
